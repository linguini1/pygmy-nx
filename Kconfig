## Kconfig
```kconfig
#
# For a description of the syntax of this configuration file,
# see the file kconfig-language.txt in the NuttX tools repository.
#

config PYGMY_STARTUP_BUZZER
	bool "Startup buzzer"
	default y
	---help---
		Turn on the buzzer at startup.
```
